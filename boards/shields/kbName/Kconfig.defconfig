## boards/shields/kbName/Kconfig.defconfig
```kconfig
# Required files for ZMK to recognize the shield

if TRACKTOTEM

# Name must be less than 16 characters long!
config ZMK_KEYBOARD_NAME
    default "tracktotem"

endif
```

## boards/shields/tracktotem_left/Kconfig.defconfig
```kconfig
# Required files for ZMK to recognize the shield

if TRACKTOTEM_LEFT

# Name must be less than 16 characters long!
config ZMK_KEYBOARD_NAME
    default "tracktotem_left"

endif
```

## boards/shields/tracktotem_right/Kconfig.defconfig
```kconfig
# Required files for ZMK to recognize the shield

if TRACKTOTEM_RIGHT

# Name must be less than 16 characters long!
config ZMK_KEYBOARD_NAME
    default "tracktotem_right"

endif
```
